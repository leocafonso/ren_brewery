## Kconfig
```kconfig
mainmenu "Project Configuration"

rsource "./boards/Kconfig"
rsource "./soc/Kconfig"
```

## boards/Kconfig
```kconfig
# SPDX-License-Identifier: BSD-3-Clause

config BOARD
    string

choice
prompt "Select Board"
rsource "./*/Kconfig.board"
endchoice

menu "Board Configuration"
rsource "./*/Kconfig"
endmenu
```

## boards/ek_ra6m4/Kconfig
```kconfig
# SPDX-License-Identifier: BSD-3-Clause
if BOARD_EK_RA6M4

config BOARD
    default "ek_ra6m4"

#### Board level drivers ####

endif
```

## boards/ek_ra6m4/Kconfig.board
```kconfig
# Copyright 2023 NXP
# All rights reserved.
#
# SPDX-License-Identifier: BSD-3-Clause


config BOARD_EK_RA6M4
    bool "ek_ra6m4"
	select SOC_R7FA6M4AF
```

## boards/ek_ra6m5/Kconfig
```kconfig
# SPDX-License-Identifier: BSD-3-Clause
if BOARD_EK_RA6M5

config BOARD
    default "ek_ra6m5"

#### Board level drivers ####

endif
```

## boards/ek_ra6m5/Kconfig.board
```kconfig
# Copyright 2023 NXP
# All rights reserved.
#
# SPDX-License-Identifier: BSD-3-Clause


config BOARD_EK_RA6M5
    bool "ek_ra6m5"
	select SOC_R7FA6M5BH
```

## drivers/Kconfig
```kconfig
# SPDX-License-Identifier: BSD-3-Clause

menu "Device Drivers"

source "drivers/serial/Kconfig"
source "drivers/gpio/Kconfig"

endmenu
```

## drivers/gpio/Kconfig
```kconfig
# SPDX-License-Identifier: BSD-3-Clause

menuconfig IOPORT
	bool "IOPORT drivers"
	help
	  Enable options for IOPORT drivers.

if IOPORT

source "drivers/gpio/Kconfig.renesas_ra"

endif # IOPORT
```

## drivers/gpio/Kconfig.renesas_ra
```kconfig
# SPDX-License-Identifier: Apache-2.0

config IOPORT_RENESAS_RA
	bool "Renesas RA Series IOPORT Driver"
	default y
	help
	  Enable Renesas RA series IOPORT driver.
```

## drivers/serial/Kconfig
```kconfig
# SPDX-License-Identifier: BSD-3-Clause

menuconfig SERIAL
	bool "Serial drivers"
	help
	  Enable options for serial drivers.

if SERIAL

source "drivers/serial/Kconfig.renesas_ra"

endif # SERIAL
```

## drivers/serial/Kconfig.renesas_ra
```kconfig
# SPDX-License-Identifier: Apache-2.0

config UART_RENESAS_RA
	bool "Renesas RA Series UART Driver"
	default y
	help
	  Enable Renesas RA series UART driver.
```

## soc/ra/ra6m4/Kconfig.soc
```kconfig
# Copyright (c) 2023 TOKITA Hiroshi <tokita.hiroshi@fujitsu.com>
# SPDX-License-Identifier: Apache-2.0

config SOC_SERIES_RA6M4
	bool
	select SOC_FAMILY_RENESAS_RA
	help
	  Renesas RA6M4

config SOC_R7FA6M4AF
	bool
	select SOC_SERIES_RA6M4
	help
	  R7FA6M4AF

config SOC_SERIES
	default "ra6m4" if SOC_SERIES_RA6M4

config SOC
	default "r7a6m4af" if SOC_R7FA6M4AF
```

## soc/ra/ra6m5/Kconfig.soc
```kconfig
# Copyright (c) 2023 TOKITA Hiroshi <tokita.hiroshi@fujitsu.com>
# SPDX-License-Identifier: Apache-2.0

config RA_MEMORY_SIZE_LETTER_H
	bool

config RA_PACKAGE_TYPE_FC
	bool

config SOC_SERIES_RA6M5
	bool
	select SOC_FAMILY_RENESAS_RA
	help
	  Renesas RA6M5

config SOC_R7FA6M5BHxxFC
	bool
	select SOC_SERIES_RA6M5
	select RA_MEMORY_SIZE_LETTER_H
	select RA_PACKAGE_TYPE_FC
	help
	  R7FA6M5BHxxFC

config SOC_SERIES
	default "ra6m5" if SOC_SERIES_RA6M5

config SOC
	default "r7fa6m5bhxxfc" if SOC_R7FA6M5BHxxFC

config RA_FAMILY
    int
	default 6 if SOC_SERIES_RA6M5

config ROM_SIZE_BYTES
	int 
	default 2097152 if RA_MEMORY_SIZE_LETTER_H

config RAM_SIZE_BYTES
	int
	default 524288 if RA_MEMORY_SIZE_LETTER_H

config DATAFLASH_SIZE_BYTES
	int
	default 8192 if RA_MEMORY_SIZE_LETTER_H

config PACKAGE_LQFP
	bool
	default y if RA_PACKAGE_TYPE_FC

config PACKAGE_PIN_SIZE
	int
	default 176 if RA_PACKAGE_TYPE_FC
```

## west.yml
```yaml
manifest:
  remotes:
  - name: ren_brewery
    url-base: https://github.com/leocafonso
  defaults:
    remote: ren_brewery
  projects:
  - name: ra_package
    revision: main
    path: modules/ra_package
  - name: cmsis
    revision: main
    path: modules/cmsis
  self:
    path: ren_brewery
    import: submanifests
```
